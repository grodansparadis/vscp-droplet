## firmware/alpha/main/Kconfig.projbuild
```kconfig
menu "ESPNOW Alpha Node Configuration"

    config FIRMWARE_UPGRADE_URL
        string "firmware upgrade url endpoint"
        default "https://193.188.2.51:443/hello_world.bin"
        help
            URL of server which hosts the firmware
            image.

    config SKIP_COMMON_NAME_CHECK
        bool "Skip server certificate CN fieldcheck"
        default n
        help
            This allows you to skip the validation of OTA server certificate CN field.

    config FIRMWARE_UPGRADE_BIND_IF
        bool "Support firmware upgrade bind specified interface"
        default n
        help
            This allows you to bind specified interface in OTA example.  

    choice FIRMWARE_UPGRADE_BIND_IF_TYPE
        prompt "Choose OTA data bind interface"
        default EXAMPLE_FIRMWARE_UPGRADE_BIND_IF_STA
        depends on EXAMPLE_FIRMWARE_UPGRADE_BIND_IF
        help
            Select which interface type of OTA data go through.

        config FIRMWARE_UPGRADE_BIND_IF_STA
            bool "Bind wifi station interface"
            depends on EXAMPLE_CONNECT_WIFI
            help
                Select wifi station interface to pass the OTA data.

        config EXAMPLE_FIRMWARE_UPGRADE_BIND_IF_ETH
            bool "Bind ethernet interface"
            depends on EXAMPLE_CONNECT_ETHERNET
            help
                Select ethernet interface to pass the OTA data.
    endchoice              

    choice PROV_TRANSPORT
        bool "Provisioning Transport"
        default PROV_TRANSPORT_SOFTAP if IDF_TARGET_ESP32S2
        default PROV_TRANSPORT_BLE
        help
            Wi-Fi provisioning component offers both, SoftAP and BLE transports. Choose one.

        config PROV_TRANSPORT_BLE
            bool "BLE"
            select BT_ENABLED
            depends on !IDF_TARGET_ESP32S2
        config PROV_TRANSPORT_SOFTAP
            bool "Soft AP"
    endchoice

    choice PROV_SECURITY_VERSION
        bool "Protocomm security version"
        default PROV_SECURITY_VERSION_1
        help
            Wi-Fi provisioning component offers 3 security versions.
            Alfa nodes need security version 1 or 2.

        config PROV_SECURITY_VERSION_1
            bool "Security version 1"
            select ESP_PROTOCOMM_SUPPORT_SECURITY_VERSION_1

        config PROV_SECURITY_VERSION_2
            bool "Security version 2"
            select ESP_PROTOCOMM_SUPPORT_SECURITY_VERSION_2
    endchoice

    choice PROV_MODE
        bool "Security version 2 mode"
        depends on PROV_SECURITY_VERSION_2
        default PROV_SEC2_DEV_MODE

        config PROV_SEC2_DEV_MODE
            bool "Security version 2 development mode"
            depends on PROV_SECURITY_VERSION_2
            help
                This enables the development mode for
                security version 2.
                Please note that this mode is NOT recommended for production purpose.

        config PROV_SEC2_PROD_MODE
            bool "Security version 2 production mode"
            depends on PROV_SECURITY_VERSION_2
            help
                This enables the production mode for
                security version 2.
    endchoice

    config PROV_TRANSPORT
        int
        default 1 if PROV_TRANSPORT_BLE
        default 2 if PROV_TRANSPORT_SOFTAP

    config RESET_PROVISIONED
        bool
        default n
        prompt "Reset provisioned status of the device"
        help
            This erases the NVS to reset provisioned status of the device on every reboot.
            Provisioned status is determined by the Wi-Fi STA configuration, saved on the NVS.

    config RESET_PROV_MGR_ON_FAILURE
        bool
        default y
        prompt "Reset provisioned credentials and state machine after session failure"
        help
            Enable reseting provisioned credentials and state machine after session failure.
            This will restart the provisioning service after retries are exhausted.

    config PROV_MGR_MAX_RETRY_CNT
        int
        default 5
        prompt "Max retries before reseting provisioning state machine"
        depends on RESET_PROV_MGR_ON_FAILURE
        help
            Set the Maximum retry to avoid reconnecting to an inexistent AP or if credentials
            are misconfigured. Provisioned credentials are erased and internal state machine
            is reset after this threshold is reached.

    config PROV_SHOW_QR
        bool "Show provisioning QR code"
        default y
        help
            Show the QR code for provisioning.

    config PROV_USING_BLUEDROID
        bool
        depends on (BT_BLUEDROID_ENABLED && (IDF_TARGET_ESP32C3 || IDF_TARGET_ESP32S3))
        select BT_BLE_42_FEATURES_SUPPORTED
        default y
        help
            This enables BLE 4.2 features for Bluedroid.

    choice ESPNOW_WIFI_MODE
        prompt "WiFi mode"
        default ESPNOW_WIFI_MODE_STATION
        help
            WiFi mode(station or softap).

        config ESPNOW_WIFI_MODE_STATION
            bool "Station"
        config ESPNOW_WIFI_MODE_STATION_SOFTAP
            bool "Softap"
    endchoice

    config ESPNOW_PMK
        string "ESPNOW primary master key"
        default "pmk1234567890123"
        help
            ESPNOW primary master for the example to use. The length of ESPNOW primary master must be 16 bytes.

    config ESPNOW_LMK
        string "ESPNOW local master key"
        default "lmk1234567890123"
        help
            ESPNOW local master for the example to use. The length of ESPNOW local master must be 16 bytes.

    config ESPNOW_CHANNEL
        int "Channel"
        default 1
        range 0 14
        help
            The channel on which sending and receiving ESPNOW data.

    config ESPNOW_ENABLE_LONG_RANGE
        bool "Enable Long Range"
        default "n"
        help
            When enable long range, the PHY rate of ESP32 will be 512Kbps or 256Kbps  
    config FIRMWARE_UPGRADE_URL
        string "Firmware upgrade url endpoint"
        default "http://192.168.0.3:8070/hello-world.bin"
        depends on ESPNOW_OTA_INITATOR
        help
            URL of server which hosts the firmware image.

    choice ESPNOW_OTA_MODE
        bool "ESP-NOW Mode"
        default ESPNOW_OTA_INITATOR
        help
            Select the ESP-NOW Mode.

        config ESPNOW_OTA_INITATOR
            bool "ESP-NOW OTA initator Mode"
            help
                Select the ESP-NOW OTA initator Mode.

        config ESPNOW_OTA_RESPONDER
            bool "ESP-NOW OTA responder Mode"
            help
                Select the ESP-NOW OTA responder Mode.

    endchoice

    config ESPNOW_OTA_MODE
        int
        default 0 if ESPNOW_OTA_INITATOR
        default 1 if ESPNOW_OTA_RESPONDER   

    config ESPNOW_SESSION_POP
        string "Proof of Possession"
        default "espnow_pop"
        help
            Proof of Possession (PoP) string used to authorize session and derive shared key.

    choice ESPNOW_SEC_MODE
        bool "ESP-NOW Mode"
        default ESPNOW_SEC_INITATOR
        help
            Select the ESP-NOW Mode.

        config ESPNOW_SEC_INITATOR
            bool "ESP-NOW SEC initator Mode"
            help
                Select the ESP-NOW SEC initator Mode.

        config ESPNOW_SEC_RESPONDER
            bool "ESP-NOW SEC responder Mode"
            help
                Select the ESP-NOW SEC responder Mode.

    endchoice

    config ESPNOW_SEC_MODE
        int
        default 0 if ESPNOW_SEC_INITATOR
        default 1 if ESPNOW_SEC_RESPONDER           

    choice ESPNOW_PROV_MODE
        bool "ESP-NOW Mode"
        default ESPNOW_PROV_INITATOR
        help
            Select the ESP-NOW Mode.

        config ESPNOW_PROV_INITATOR
            bool "ESP-NOW provisioning initiator Mode"
            help
                Select the ESP-NOW provisioning initiator Mode.

        config ESPNOW_PROV_RESPONDER
            bool "ESP-NOW provisioning responder Mode"
            help
                Select the ESP-NOW provisioning responder Mode.

    endchoice

    config ESPNOW_PROV_MODE
        int
        default 0 if ESPNOW_PROV_INITATOR
        default 1 if ESPNOW_PROV_RESPONDER

        config ESPNOW_WIFI_SSID
            string "WiFi SSID"
            depends on ESPNOW_PROV_RESPONDER
            default "myssid"
            help
                SSID (network name) for the example to connect to.

        config ESPNOW_WIFI_PASSWORD
            string "WiFi Password"
            depends on ESPNOW_PROV_RESPONDER
            default "mypassword"
            help
                WiFi password (WPA or WPA2) for the example to use.
  
endmenu
```

## firmware/alpha5/main/Kconfig.projbuild
```kconfig
menu "Alpha Node Configuration"

    choice EXAMPLE_PROV_TRANSPORT
        bool "Provisioning Transport"
        default EXAMPLE_PROV_TRANSPORT_SOFTAP if IDF_TARGET_ESP32S2
        default EXAMPLE_PROV_TRANSPORT_BLE
        help
            Wi-Fi provisioning component offers both, SoftAP and BLE transports. Choose any one.

        config EXAMPLE_PROV_TRANSPORT_BLE
            bool "BLE"
            select BT_ENABLED
            depends on !IDF_TARGET_ESP32S2
        config EXAMPLE_PROV_TRANSPORT_SOFTAP
            bool "Soft AP"
    endchoice

    choice EXAMPLE_PROV_SECURITY_VERSION
        bool "Protocomm security version"
        default EXAMPLE_PROV_SECURITY_VERSION_2
        help
            Wi-Fi provisioning component offers 3 security versions.
            The example offers a choice between security version 1 and 2.

        config EXAMPLE_PROV_SECURITY_VERSION_1
            bool "Security version 1"
            select ESP_PROTOCOMM_SUPPORT_SECURITY_VERSION_1

        config EXAMPLE_PROV_SECURITY_VERSION_2
            bool "Security version 2"
            select ESP_PROTOCOMM_SUPPORT_SECURITY_VERSION_2
    endchoice

    choice EXAMPLE_PROV_MODE
        bool "Security version 2 mode"
        depends on EXAMPLE_PROV_SECURITY_VERSION_2
        default EXAMPLE_PROV_SEC2_DEV_MODE

        config EXAMPLE_PROV_SEC2_DEV_MODE
            bool "Security version 2 development mode"
            depends on EXAMPLE_PROV_SECURITY_VERSION_2
            help
                This enables the development mode for
                security version 2.
                Please note that this mode is NOT recommended for production purpose.

        config EXAMPLE_PROV_SEC2_PROD_MODE
            bool "Security version 2 production mode"
            depends on EXAMPLE_PROV_SECURITY_VERSION_2
            help
                This enables the production mode for
                security version 2.
    endchoice

    config EXAMPLE_PROV_TRANSPORT
        int
        default 1 if EXAMPLE_PROV_TRANSPORT_BLE
        default 2 if EXAMPLE_PROV_TRANSPORT_SOFTAP

    config EXAMPLE_RESET_PROVISIONED
        bool
        default n
        prompt "Reset provisioned status of the device"
        help
            This erases the NVS to reset provisioned status of the device on every reboot.
            Provisioned status is determined by the Wi-Fi STA configuration, saved on the NVS.

    config EXAMPLE_RESET_PROV_MGR_ON_FAILURE
        bool
        default y
        prompt "Reset provisioned credentials and state machine after session failure"
        help
            Enable reseting provisioned credentials and state machine after session failure.
            This will restart the provisioning service after retries are exhausted.

    config EXAMPLE_PROV_MGR_MAX_RETRY_CNT
        int
        default 5
        prompt "Max retries before reseting provisioning state machine"
        depends on EXAMPLE_RESET_PROV_MGR_ON_FAILURE
        help
            Set the Maximum retry to avoid reconnecting to an inexistent AP or if credentials
            are misconfigured. Provisioned credentials are erased and internal state machine
            is reset after this threshold is reached.

    config EXAMPLE_PROV_SHOW_QR
        bool "Show provisioning QR code"
        default y
        help
            Show the QR code for provisioning.

    config EXAMPLE_PROV_USING_BLUEDROID
        bool
        depends on (BT_BLUEDROID_ENABLED && (IDF_TARGET_ESP32C3 || IDF_TARGET_ESP32S3))
        select BT_BLE_42_FEATURES_SUPPORTED
        default y
        help
            This enables BLE 4.2 features for Bluedroid.

    config BUTTON_PERIOD_TIME_MS
        int "BUTTON PERIOD TIME (MS)"
        range 2 20
        default 5
        help
            "Button scan interval"

    config BUTTON_DEBOUNCE_TICKS
        int "BUTTON DEBOUNCE TICKS"
        range 1 8
        default 2
        help
            "One CONFIG_BUTTON_DEBOUNCE_TICKS equal to CONFIG_BUTTON_PERIOD_TIME_MS"

    config BUTTON_SHORT_PRESS_TIME_MS
        int "BUTTON SHORT PRESS TIME (MS)"
        range 50 800
        default 180

    config BUTTON_LONG_PRESS_TIME_MS
        int "BUTTON LONG PRESS TIME (MS)"
        range 500 5000
        default 1500

    config BUTTON_SERIAL_TIME_MS
        int "BUTTON SERIAL TIME (MS)"
        range 2 1000
        default 20
        help
            "Serial trigger interval"

    config ADC_BUTTON_MAX_CHANNEL
        int "ADC BUTTON MAX CHANNEL"
        range 1 5
        default 3
        help
            "Maximum number of channels for ADC buttons"

    config ADC_BUTTON_MAX_BUTTON_PER_CHANNEL
        int "ADC BUTTON MAX BUTTON PER CHANNEL"
        range 1 10
        default 8
        help
            "Maximum number of buttons per channel"

    config ADC_BUTTON_SAMPLE_TIMES
        int "ADC BUTTON SAMPLE TIMES"
        range 1 4
        default 1
        help
            "Number of samples per scan"        
endmenu
```
